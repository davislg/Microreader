#include	<p24FJ64GB002.h>
#include 	<i2c.h>
#include "disp.h"



#define	idle_iic			IdleI2C2
#define	start_iic			StartI2C2
#define	master_write_iic	MasterWriteI2C2
#define	master_read_iic		MasterReadI2C2
#define	not_ack_iic			NotAckI2C2
#define	stop_iic			StopI2C2
#define	rstart_iic			RestartI2C2
#define	ack_iic				AckI2C2
#define	PEN_BIT				I2C2CONbits.PEN
#define	SEN_BIT				I2C2CONbits.SEN
#define	RSEN_BIT			I2C2CONbits.RSEN

const char font5x7[455] =
   {0x00, 0x00, 0x00, 0x00, 0x00 ,  // sp
    0x00, 0x00, 0x2f, 0x00, 0x00 ,  // !
    0x00, 0x07, 0x00, 0x07, 0x00 ,  // "
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    0x44, 0x64, 0x54, 0x4C, 0x44};  // z 
    
    

void shdn_disp (void)
{
lcd_cmd (0xAE);
}

void init_lcd (void)
{
/*
When RES# input is LOW, the chip is initialized with the following status:
1. Display is OFF
2. 128 x 39 Display Mode
3. Normal segment and display data column address and row address mapping (SEG0 mapped to
address 00h and COM0 mapped to address 00h)
4. Shift register data clear in serial interface
5. Display start line is set at display RAM address 0
6. Column address counter is set at 0
7. Normal scan direction of the COM outputs
8. Contrast control register is set at 7Fh
9. Normal display mode (Equivalent to A4h command)
*/
lcd_cmd (0xAE);//1
lcd_cmd (0xA1);//3
lcd_cmd (0xA4);//9
lcd_cmd (0x40);
lcd_cmd (0xC0);
lcd_cmd (0x00);
lcd_cmd (0x10);
lcd_cmd (0xAF);
clrscr(0x00);
}

void refresh_lcd (unsigned char * buff)
{
disp_set_xy(0,0);
putslcd2(buff+ROW0);
disp_set_xy(0,1);
putslcd2(buff+ROW1);
disp_set_xy(0,2);
putslcd2(buff+ROW2);
disp_set_xy(0,3);
putslcd2(buff+ROW3);
}

void putslcd2(char *data)
{
unsigned int counter;
counter=0;
iic_start();
iic_write(0x78);
iic_write(0x40);
while(counter<DISP_COLS)
	{  
  	char_print2(*data);
	*data++;
	counter++;
  	}
iic_stop();
}

void char_print2 (unsigned char data)
{
unsigned char underline;
unsigned int	disp_loop_var;
unsigned int temp;

if (data&0x80) underline = 1;
	else underline = 0;
data = data&0x7F;
if (data<' ') data = ' ';
temp = ((unsigned int)(data - 0x20)*5);
for (disp_loop_var=0;disp_loop_var<5;disp_loop_var++)
	{
	if (underline==1)	iic_write ((font5x7[temp+disp_loop_var])^0xFF) ;	
	else 				iic_write(font5x7[temp+disp_loop_var]);	
	}
if (underline==1)
	iic_write(0xFF);	
else
	iic_write(0x00);	
}


void putslcd(char *data)
{
unsigned int counter;
	counter=0;
		while(counter<DISP_COLS)
//		while((*data != '\0')&(counter<DISP_COLS))
  			{  
		  	char_print(*data);
			*data++;
			counter++;
		  	}
}

void char_print (unsigned char data)
{
unsigned char underline;
unsigned int	disp_loop_var;
unsigned int temp;
iic_start();
iic_write(0x78);
iic_write(0x40);
if (data&0x80) underline = 1;
	else underline = 0;
data = data&0x7F;
if (data<' ') data = ' ';
temp = ((unsigned int)(data - 0x20)*5);
for (disp_loop_var=0;disp_loop_var<5;disp_loop_var++)
	{
	if (underline==1)	iic_write ((font5x7[temp+disp_loop_var])^0xFF) ;	
	else 				iic_write(font5x7[temp+disp_loop_var]);	
	}
if (underline==1)
	iic_write(0xFF);	
else
	iic_write(0x00);	
iic_stop();

}


void clrscr (unsigned char data)
{
unsigned char x,y;
for (y=0;y<4;y++)
	{
	disp_set_xy(0,y);
	iic_start();
	iic_write(0x78);
	iic_write(0x40);
	for (x=0;x<96;x++)
		iic_write(data);
	iic_stop();
	}
}

void disp_set_xy (unsigned char x, unsigned char y)
{
if (y>3) return;
if (x>95) return;
lcd_cmd (0xB0+y);
lcd_cmd (0x00 + (x&0x0F));
lcd_cmd (0x10 + ((x>>4)&0x0F));
}
void lcd_cmd(unsigned char data)
{
iic_start();
iic_write(0x78);
iic_write(0x80);
iic_write(data);
iic_stop();
}

void iic_start (void)
{
 	idle_iic();
  	start_iic();
	while(SEN_BIT);
}

void iic_stop (void)
{
 	idle_iic();
	stop_iic();
	  /* Wait till stop sequence is completed */
	while(PEN_BIT);
}

void iic_write (unsigned char data)
{
 	idle_iic();
	master_write_iic(data);
}
